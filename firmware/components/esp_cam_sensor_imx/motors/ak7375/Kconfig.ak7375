## firmware/components/esp_cam_sensor_imx/motors/ak7375/Kconfig.ak7375
```kconfig
menuconfig CAM_MOTOR_AK7375
    bool "AK7375 VCM (Arducam IMX519 autofocus)"
    default n
    select CAMERA_MOTOR_DEVICE_USED
    help
        Enable the Asahi Kasei AK7375 voice-coil-motor driver, the autofocus
        actuator on the Arducam 16MP IMX519 module, at I2C 0x0c on the same
        bus as the sensor. 12-bit DAC (0..4095).

if CAM_MOTOR_AK7375

    config CAM_MOTOR_AK7375_AUTO_DETECT
        bool "Auto-detect the AK7375"
        default y

    config CAM_MOTOR_AK7375_INIT_POS
        int "Lens park position at start-up (DAC code)"
        range 0 4095
        default 2048
        help
            Where the lens is placed as soon as the motor is detected. Measure
            with the focus sweep; libcamera's imx519 tuning maps 0..15
            dioptres onto roughly 445..925 on this DAC.

    config CAM_MOTOR_AK7375_PERIOD_US
        int "Settling time allowed per DAC code (microseconds)"
        range 1 65535
        default 1000

endif # CAM_MOTOR_AK7375
```

## firmware/esp-idf/components/esp_cam_sensor_imx/Kconfig
```kconfig
menu "Camera Sensor (IMX add-on)"

    config CAMERA_IMX519
        bool "Support IMX519 (Arducam 16MP autofocus)"
        default n
        help
            Enable the Sony IMX519 MIPI-CSI driver (Arducam 16MP AF module).
            Modes are 2x2-binned RAW10 crops; autofocus is the separate AK7375
            VCM driver below.

    if CAMERA_IMX519

        config CAMERA_IMX519_AUTO_DETECT_MIPI_INTERFACE_SENSOR
            bool "Auto-detect IMX519 on the MIPI-CSI interface"
            default y

        config CAMERA_IMX519_MIPI_IF_FORMAT_INDEX_DEFAULT
            int "Default MIPI-CSI mode index"
            default 0
            range 0 2
            help
              0 - 1920x1080 RAW10 30fps, 2x2 binned crop of a 3840x2160 window (82% FOV)
              1 - 1280x720 RAW10 30fps, 2x2 binned crop of a 2560x1440 window (55% FOV)
              2 - 2328x1748 RAW10 30fps, 2x2 binned full field. Wider than the
                  P4 datapath limit (~1920); experimental.

        config CAMERA_IMX519_DEBUG_LOG
            bool "Log every exposure and gain write (bench debugging)"
            default n
            help
                Prints each exposure/gain request the ISP's auto-exposure makes
                and what the driver actually wrote. Useful when AE misbehaves;
                noisy otherwise. Off in shipping builds.

    endif # CAMERA_IMX519

endmenu

menu "Camera Motor (IMX add-on)"

    rsource "motors/ak7375/Kconfig.ak7375"

endmenu
```

## firmware/esp-idf/components/mirror_board/Kconfig
```kconfig
# ---------------------------------------------------------------------------
# What a board is, in Kconfig.
#
# Every option here DECLARES something a board may have; none of them carries a
# board's value. The values live in boards/<name>/sdkconfig.defaults, which is
# the one file a new board has to write - see "Adding a new board" in
# firmware/esp-idf/README.md. The four adapter pieces (camera, button, signal
# LED, capture flash) all follow that same rule, so "where is this pin set?"
# has one answer instead of four.
#
# GPIO defaults are -1 and booleans default n, so a board that forgets an
# option loses that feature visibly rather than driving GPIO 0 or inverting an
# LED it never configured.
# ---------------------------------------------------------------------------
menu "Daily Mirror board"

choice MIRROR_BOARD
    prompt "Target board"
    default MIRROR_BOARD_P4_IMX519 if IDF_TARGET_ESP32P4
    default MIRROR_BOARD_S3_OV5640 if IDF_TARGET_ESP32S3
    help
        Which hardware this image is for. Normally set by the per-board
        sdkconfig.defaults file that `-DMIRROR_BOARD=<name>` selects; see
        firmware/README.md. Exactly one board adapter is compiled in.

    config MIRROR_BOARD_P4_IMX519
        bool "ESP32-P4 + Arducam IMX519 (MIPI-CSI, AK7375 autofocus)"
        depends on IDF_TARGET_ESP32P4

    config MIRROR_BOARD_S3_OV5640
        bool "ESP32-S3 + OV5640 (DVP, AF firmware blob)"
        depends on IDF_TARGET_ESP32S3

endchoice

config MIRROR_BUTTON_GPIO
    int "Shutter button GPIO (momentary switch to GND, internal pull-up)"
    default -1
    range -1 56
    help
        The press flow's button. -1 disables the button task, leaving
        POST /press as the only trigger.

        Every board sets this in its own boards/<name>/sdkconfig.defaults -
        see "Adding a new board" in firmware/esp-idf/README.md. The default
        here is -1 on purpose: a board that forgets loses its button, which is
        obvious, rather than quietly driving GPIO 0.

config MIRROR_JPEG_QUALITY
    int "JPEG quality (0-100)"
    default 90
    range 10 100
    help
        On the P4 this is the hardware encoder's quality. On the S3 it is
        mapped onto esp32-camera's inverted 0-63 scale.

menu "Capture flash"

config MIRROR_FLASH_GPIO
    int "Capture flash / fill light GPIO (-1 disables it)"
    default -1
    range -1 56
    help
        A light that comes on for the photograph. -1 means there is none, and
        nothing below has any effect.

        Set per board in boards/<name>/sdkconfig.defaults; -1 here so a board
        with no light compiles the flash away to nothing.

        Driven straight from the pin today, which limits it to whatever the
        GPIO can source. A MOSFET stage is coming; board_flash_set_level()
        already takes a 0-255 level so LEDC dimming can replace the plain
        on/off without changing anything above the board adapter.

config MIRROR_FLASH_ACTIVE_HIGH
    bool "The flash pin is active high"
    default n
    help
        Unset for a low-side driver that turns the light on when the pin is
        pulled low.

config MIRROR_FLASH_LEAD_MS
    int "Milliseconds the flash is on before the shutter"
    default 1500
    range 0 4000
    help
        The light comes on this long before the frame is taken, during the
        last part of the press countdown, and stays on through the grab.

        This is not a strobe and must not become one. Auto-exposure, white
        balance and autofocus all have to settle WITH the light on, or the
        frame is metered for the dark room and comes out blown out; and a
        pulse shorter than a frame lights only part of a rolling-shutter
        readout. Both are written up in docs/burst-processing-experiment.md
        ("hold illumination steady through settling and the entire capture")
        and docs/imx519-sensor-profile-guide.md.

        The frame flush that settles auto-exposure runs after the light is on -
        see board_camera_prepare_settle().

endmenu # Capture flash

menu "Status LED"

if MIRROR_BOARD_S3_OV5640

config MIRROR_LED_WS2812_GPIO
    int "WS2812 data GPIO"
    default -1
    range -1 48
    help
        The single addressable LED on the Freenove ESP32-S3-WROOM CAM board.

endif # MIRROR_BOARD_S3_OV5640

if MIRROR_BOARD_P4_IMX519

config MIRROR_LED_R_GPIO
    int "RGB LED red GPIO (LEDC PWM)"
    default -1
    range -1 56

config MIRROR_LED_G_GPIO
    int "RGB LED green GPIO (LEDC PWM)"
    default -1
    range -1 56

config MIRROR_LED_B_GPIO
    int "RGB LED blue GPIO (LEDC PWM)"
    default -1
    range -1 56

config MIRROR_LED_COMMON_ANODE
    bool "RGB LED is common anode (common leg to 3V3)"
    default n
    help
        A four-leg RGB LED with one 330 ohm resistor per colour. Common anode
        means the common leg goes to 3V3 and each channel is pulled low to
        light, so the PWM duty is inverted. Get this backwards and the LED is
        on when it should be off and vice versa - it is not a wiring fault, it
        is this flag.

endif # MIRROR_BOARD_P4_IMX519

endmenu # Status LED

menu "Camera pins"

if MIRROR_BOARD_P4_IMX519

config MIRROR_CAM_SCCB_SDA_GPIO
    int "Camera I2C (SCCB) SDA GPIO"
    default -1
    range -1 56

config MIRROR_CAM_SCCB_SCL_GPIO
    int "Camera I2C (SCCB) SCL GPIO"
    default -1
    range -1 56

endif # MIRROR_BOARD_P4_IMX519

if MIRROR_BOARD_S3_OV5640

config MIRROR_CAM_XCLK_GPIO
    int "Camera XCLK GPIO"
    default -1
config MIRROR_CAM_SDA_GPIO
    int "Camera SCCB SDA GPIO"
    default -1
config MIRROR_CAM_SCL_GPIO
    int "Camera SCCB SCL GPIO"
    default -1
config MIRROR_CAM_D0_GPIO
    int "Camera D0 GPIO"
    default -1
config MIRROR_CAM_D1_GPIO
    int "Camera D1 GPIO"
    default -1
config MIRROR_CAM_D2_GPIO
    int "Camera D2 GPIO"
    default -1
config MIRROR_CAM_D3_GPIO
    int "Camera D3 GPIO"
    default -1
config MIRROR_CAM_D4_GPIO
    int "Camera D4 GPIO"
    default -1
config MIRROR_CAM_D5_GPIO
    int "Camera D5 GPIO"
    default -1
config MIRROR_CAM_D6_GPIO
    int "Camera D6 GPIO"
    default -1
config MIRROR_CAM_D7_GPIO
    int "Camera D7 GPIO"
    default -1
config MIRROR_CAM_VSYNC_GPIO
    int "Camera VSYNC GPIO"
    default -1
config MIRROR_CAM_HREF_GPIO
    int "Camera HREF GPIO"
    default -1
config MIRROR_CAM_PCLK_GPIO
    int "Camera PCLK GPIO"
    default -1

config MIRROR_CAM_VFLIP
    bool "Flip the image vertically"
    default n
    help
        Set per board. The Freenove module is mounted upside down on the bench
        rig, so boards/s3_ov5640/sdkconfig.defaults turns this on.

config MIRROR_CAM_HMIRROR
    bool "Mirror the image horizontally"
    default n

endif # MIRROR_BOARD_S3_OV5640

endmenu # Camera pins

endmenu # Daily Mirror board
```

## firmware/esp-idf/components/mirror_config/Kconfig
```kconfig
menu "Daily Mirror settings defaults"

    comment "Build-time fallbacks used only when NVS has no value."
    comment "Leave empty in git; set them in a git-ignored sdkconfig for bench builds."

    config MIRROR_DEFAULT_WIFI_SSID
        string "Default Wi-Fi SSID"
        default ""
        help
            Used when no SSID has been stored through the /config page.
            Keep this empty in anything committed to the repository.

    config MIRROR_DEFAULT_WIFI_PASS
        string "Default Wi-Fi password"
        default ""
        help
            Used when no password has been stored through the /config page.
            This ends up in the firmware image in plain text, so set it only in
            a git-ignored sdkconfig on a bench build, never in source control.

    config MIRROR_DEFAULT_SERVER_URL
        string "Default server URL"
        default ""
        help
            Base URL uploads are sent to, e.g. https://mirror.example.com.
            Must start with http:// or https:// when non-empty.

    config MIRROR_DEFAULT_UPLOAD_TOKEN
        string "Default upload token"
        default ""
        help
            Bearer token for the upload server. Same warning as the Wi-Fi
            password: a build-time default is baked into the image.

endmenu
```

## firmware/esp-idf/main/Kconfig.projbuild
```kconfig
menu "Daily Mirror application"

config MIRROR_FW_VERSION
    string "Firmware version reported in mDNS and /stats"
    default "0.1.0"

config MIRROR_STA_TIMEOUT_S
    int "Seconds to wait for a station address before starting the setup network"
    default 60
    range 10 600
    help
        The station keeps trying forever in the background either way; this is
        only how long the device waits before *also* offering the fallback
        access point, so someone can reach /config and fix the credentials.

config MIRROR_AP_PASSWORD
    string "WPA2 password for the fallback setup network"
    default "dailymirror"
    help
        The setup access point is named after the mDNS hostname
        (mirror-<last 3 MAC bytes>) and carries the same admin server, so
        /config is reachable on a device that has never joined a network.

        Eight characters or more, or the network comes up open. This is a
        build-time default for bench units and is documented in
        firmware/README.md - it is not a secret, and a shipping product should
        derive a per-device password instead.

config MIRROR_PROV_USERNAME
    string "Provisioning username (protocomm security 2 / SRP6a)"
    default "mirror"
    help
        The SRP6a username the mobile app authenticates with. It is not a
        secret - it is half of an agreed identity - but it must be byte for
        byte what the app passes to ESPDevice.connect(), or the handshake
        fails before any data is exchanged.

        The salt and verifier are derived from this and MIRROR_PROV_POP at
        start-up, so changing either here is enough; there is no array to
        regenerate with Espressif's esp_prov tooling.

config MIRROR_PROV_POP
    string "Provisioning proof of possession"
    default "daily-mirror"
    help
        The SRP6a password. The app must pass the same string as the proof of
        possession, and the pairing session is encrypted with a key derived
        from it, so a phone that does not know it cannot send this device
        Wi-Fi credentials or a claim token.

        This build-time default is shared by every bench unit and is in the
        repository, so it is not a secret in any useful sense. A shipping
        product should derive a per-device value and print it on the device or
        its box; the firmware only needs the string to change here for that to
        work.

config MIRROR_DEBUG_ISP_STATS
    bool "Log the ISP 3A statistics at debug level"
    default n
    help
        Turns esp_ipa and esp_video up to DEBUG at start-up: every
        auto-exposure decision, white-balance gain and autofocus score. This is
        how the IMX519's focus band and the purple-blacks pedestal were found,
        so it stays available - but it is far too noisy to leave on, and on the
        ESP32-S3 (which has no ISP) it does nothing.

        See also CAMERA_IMX519_DEBUG_LOG under "Camera Sensor (IMX add-on)",
        which logs the sensor-side exposure and gain writes.

endmenu
```

## firmware/main/Kconfig.projbuild
```kconfig
menu "Daily Mirror application"

config MIRROR_FW_VERSION
    string "Firmware version reported in mDNS and /stats"
    default "0.1.0"

config MIRROR_STA_TIMEOUT_S
    int "Seconds to wait for a station address before starting the setup network"
    default 60
    range 10 600
    help
        The station keeps trying forever in the background either way; this is
        only how long the device waits before *also* offering the fallback
        access point, so someone can reach /config and fix the credentials.

config MIRROR_AP_PASSWORD
    string "WPA2 password for the fallback setup network"
    default "dailymirror"
    help
        The setup access point is named after the mDNS hostname
        (mirror-<last 3 MAC bytes>) and carries the same admin server, so
        /config is reachable on a device that has never joined a network.

        Eight characters or more, or the network comes up open. This is a
        build-time default for bench units and is documented in
        firmware/README.md - it is not a secret, and a shipping product should
        derive a per-device password instead.

config MIRROR_DEBUG_ISP_STATS
    bool "Log the ISP 3A statistics at debug level"
    default n
    help
        Turns esp_ipa and esp_video up to DEBUG at start-up: every
        auto-exposure decision, white-balance gain and autofocus score. This is
        how the IMX519's focus band and the purple-blacks pedestal were found,
        so it stays available - but it is far too noisy to leave on, and on the
        ESP32-S3 (which has no ISP) it does nothing.

        See also CAMERA_IMX519_DEBUG_LOG under "Camera Sensor (IMX add-on)",
        which logs the sensor-side exposure and gain writes.

endmenu
```
